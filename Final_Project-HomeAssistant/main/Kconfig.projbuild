## Final_Project-HomeAssistant/main/Kconfig.projbuild
```kconfig
menu "HomeAssistant Configuration"
    orsource "$IDF_PATH/examples/common_components/env_caps/$IDF_TARGET/Kconfig.env_caps"
    
    menu "LED Configuration"
        choice BLINK_LED
            prompt "Blink LED type"
            default BLINK_LED_GPIO
            help
                Select the LED type. A normal level controlled LED or an addressable LED strip.
                The default selection is based on the Espressif DevKit boards.
                You can change the default selection according to your board.

            config BLINK_LED_GPIO
                bool "GPIO"
            config BLINK_LED_STRIP
                bool "LED strip"
        endchoice

        choice BLINK_LED_STRIP_BACKEND
            depends on BLINK_LED_STRIP
            prompt "LED strip backend peripheral"
            default BLINK_LED_STRIP_BACKEND_RMT if SOC_RMT_SUPPORTED
            default BLINK_LED_STRIP_BACKEND_SPI
            help
                Select the backend peripheral to drive the LED strip.

            config BLINK_LED_STRIP_BACKEND_RMT
                depends on SOC_RMT_SUPPORTED
                bool "RMT"
            config BLINK_LED_STRIP_BACKEND_SPI
                bool "SPI"
        endchoice

        config BLINK_GPIO
            int "Blink GPIO number"
            range ENV_GPIO_RANGE_MIN ENV_GPIO_OUT_RANGE_MAX
            default 8
            help
                GPIO number (IOxx) to blink on and off the LED.
                Some GPIOs are used for other purposes (flash connections, etc.) and cannot be used to blink.

        config BLINK_PERIOD
            int "Blink period in ms"
            range 10 3600000
            default 1000
            help
                Define the blinking period in milliseconds.
    endmenu

    menu "Button Configuration"
        config POTENTIOMETER_ACTIVE
            bool "Potentiometer Active"
            default n
            help
                If the potentiometer is active. This blocks the right button, since the GPIO is used otherwise.

        config BUTTON_GPIO
            int "Button GPIO"
            depends on POTENTIOMETER_ACTIVE
            default 9
            help
                GPIO the Button is connected to. In the book it is 6, the book development board uses 9.

        config BUTTON_GPIO_LEFT
            int "Left Button GPIO"
            depends on !POTENTIOMETER_ACTIVE
            default 9
            help
                GPIO the Button is connected to. In the book it is 6, the book development board uses 9.

        config BUTTON_GPIO_RIGHT
            int "Right Button GPIO"
            depends on !POTENTIOMETER_ACTIVE
            default 2
            help
                GPIO the Button is connected to. The book development board uses 2.

        config ENABLE_GPIO_PULLDOWN
            bool "Enable GPIO PullDown"
            default n
            help
                If the Buttons are configured to use PullDown. Uses PullUp otherwise.
    endmenu

    menu "Potentiometer Configuration"
        choice POTENTIOMETER_ADC_FILTER
            prompt "Potentiometer ADC filter"
            default POTENTIOMETER_ADC_FILTER_IIR
            help
                Select the ADC filter to use for the potentiometer.
                The IIR filter is the default and recommended for most applications.
                The FIR filters are useful for applications that require a specific response time.

            config POTENTIOMETER_ADC_FILTER_NONE
                bool "Use no Filter"
                help
                    Use no Filter for the ADC values.
            config POTENTIOMETER_ADC_FILTER_FIR_2
                bool "Use FIR Filter order 2"
                help
                    Use FIR Filter order 2 with parameters ( 0.5, 0.5 )
            config POTENTIOMETER_ADC_FILTER_FIR_10
                bool "Use FIR Filter order 10"
                help
                    Use IIR Filter order 10 with parameters (0.1, 0.1, 0.1, 0.1, 0.1, 0.1, 0.1, 0.1, 0.1, 0.1)
            config POTENTIOMETER_ADC_FILTER_IIR
                bool "Use IIR Filter"
                help
                    Use IIR Filter with parameters (0.4142, 0.0, 0.2929, 0.2929, 0.0)
        endchoice
    endmenu

    menu "WIFI Configuration"
        config WIFI_SSID
            string "WiFi SSID"
            default "SSID"
            help
                SSID (network name) for the example to connect to.

        config WIFI_PASSWORD
            string "WiFi Password"
            default "PASS"
            help
                WiFi password (WPA or WPA2) for the example to use.

        choice WIFI_SAE_MODE
            prompt "WPA3 SAE mode selection"
            default WPA3_SAE_PWE_BOTH
            help
                Select mode for SAE as Hunt and Peck, H2E or both.
            config WPA3_SAE_PWE_HUNT_AND_PECK
                bool "HUNT AND PECK"
            config WPA3_SAE_PWE_HASH_TO_ELEMENT
                bool "H2E"
            config WPA3_SAE_PWE_BOTH
                bool "BOTH"
        endchoice

        config WIFI_PW_ID
            string "PASSWORD IDENTIFIER"
            depends on  WPA3_SAE_PWE_HASH_TO_ELEMENT|| WPA3_SAE_PWE_BOTH
            default ""
            help
                password identifier for SAE H2E

        choice WIFI_SCAN_AUTH_MODE_THRESHOLD
            prompt "WiFi Scan auth mode threshold"
            default WIFI_AUTH_WPA2_PSK
            help
                The weakest authmode to accept in the scan mode.
                This value defaults to WIFI_AUTH_WPA2_PSK incase password is present and WIFI_AUTH_OPEN is used.
                Please select WIFI_AUTH_WEP/WIFI_AUTH_WPA_PSK incase AP is operating in WEP/WPA mode.

            config WIFI_AUTH_OPEN
                bool "OPEN"
            config WIFI_AUTH_WEP
                bool "WEP"
            config WIFI_AUTH_WPA_PSK
                bool "WPA PSK"
            config WIFI_AUTH_WPA2_PSK
                bool "WPA2 PSK"
            config WIFI_AUTH_WPA_WPA2_PSK
                bool "WPA/WPA2 PSK"
            config WIFI_AUTH_WPA3_PSK
                bool "WPA3 PSK"
            config WIFI_AUTH_WPA2_WPA3_PSK
                bool "WPA2/WPA3 PSK"
            config WIFI_AUTH_WAPI_PSK
                bool "WAPI PSK"
        endchoice
    endmenu

    menu "Remote Connection Configuration"
        config IPV4_ADDR
            string "IPV4 Address"
            default "127.0.0.1"
            help
                IPV4 address to which the client example will send data.

        config PORT
            int "Port"
            range 0 65535
            default 15651
            help
                The remote port to which the client example will send data.

        choice TRANSPORT_LAYER
            prompt "Transport Layer"
            default TRANSPORT_MQTT
            help
                Selects the transport layer protocol.

            config TRANSPORT_MQTT
                bool "MQTT"

            config TRANSPORT_UDP
                bool "UDP"

            config TRANSPORT_TCP
                bool "TCP"
        endchoice
    endmenu

    menu "MQTT Configuration"
        config MQTT_BROKER_URL
            string "MQTT Broker URL"
            default "mqtt://test.mosquitto.org"
            help
                URL of the MQTT Broker used
            
        config MQTT_BROKER_USERNAME
            string "MQTT user name"
            default ""
            help
                User name for MQTT broker login

        config MQTT_BROKER_PASSWORD
            string "MQTT password"
            default ""
            help
                Password for MQTT broker login

        config USE_DEFAULT_TOPIC
            bool "Use default topic"
            default n
            help
                If a default dopic for all the the messages should be used.
            
        config MQTT_TOPIC
            string "MQTT Topic"
            depends on USE_DEFAULT_TOPIC
            default "ESP32/test"
            help
                MQTT Topic used to send the data

        config MQTT_TOPIC_PREFIX
            string "MQTT Topic Prefix"
            depends on !USE_DEFAULT_TOPIC
            default "ESP32/test"
            help
                If not empty, this prefix is added to the topic of each message.
    endmenu

endmenu
```

## Lecture6-RS-485/main/Kconfig.projbuild
```kconfig
menu "Lecture5 Configuration"
    menu "WIFI Configuration"
        config WIFI_SSID
            string "WiFi SSID"
            default "SSID"
            help
                SSID (network name) for the example to connect to.

        config WIFI_PASSWORD
            string "WiFi Password"
            default "PASS"
            help
                WiFi password (WPA or WPA2) for the example to use.

        choice WIFI_SAE_MODE
            prompt "WPA3 SAE mode selection"
            default WPA3_SAE_PWE_BOTH
            help
                Select mode for SAE as Hunt and Peck, H2E or both.
            config WPA3_SAE_PWE_HUNT_AND_PECK
                bool "HUNT AND PECK"
            config WPA3_SAE_PWE_HASH_TO_ELEMENT
                bool "H2E"
            config WPA3_SAE_PWE_BOTH
                bool "BOTH"
        endchoice

        config WIFI_PW_ID
            string "PASSWORD IDENTIFIER"
            depends on  WPA3_SAE_PWE_HASH_TO_ELEMENT|| WPA3_SAE_PWE_BOTH
            default ""
            help
                password identifier for SAE H2E

        choice WIFI_SCAN_AUTH_MODE_THRESHOLD
            prompt "WiFi Scan auth mode threshold"
            default WIFI_AUTH_WPA2_PSK
            help
                The weakest authmode to accept in the scan mode.
                This value defaults to WIFI_AUTH_WPA2_PSK incase password is present and WIFI_AUTH_OPEN is used.
                Please select WIFI_AUTH_WEP/WIFI_AUTH_WPA_PSK incase AP is operating in WEP/WPA mode.

            config WIFI_AUTH_OPEN
                bool "OPEN"
            config WIFI_AUTH_WEP
                bool "WEP"
            config WIFI_AUTH_WPA_PSK
                bool "WPA PSK"
            config WIFI_AUTH_WPA2_PSK
                bool "WPA2 PSK"
            config WIFI_AUTH_WPA_WPA2_PSK
                bool "WPA/WPA2 PSK"
            config WIFI_AUTH_WPA3_PSK
                bool "WPA3 PSK"
            config WIFI_AUTH_WPA2_WPA3_PSK
                bool "WPA2/WPA3 PSK"
            config WIFI_AUTH_WAPI_PSK
                bool "WAPI PSK"
        endchoice
    endmenu

    menu "MQTT Configuration"
        config MQTT_BROKER_URL
            string "MQTT Broker URL"
            default "mqtt://test.mosquitto.org"
            help
            URL of the MQTT Broker used
            
        config MQTT_BROKER_USERNAME
            string "MQTT user name"
            default ""
            help
            User name for MQTT broker login

        config MQTT_BROKER_PASSWORD
            string "MQTT password"
            default ""
            help
            Password for MQTT broker login
            
        config MQTT_TOPIC
            string "MQTT Topic"
            default "ESP32/test"
            help
            MQTT Topic used to send the data
    endmenu

    menu "Remote Connection Configuration"
        config IPV4_ADDR
            string "IPV4 Address"
            default "127.0.0.1"
            help
                IPV4 address to which the client example will send data.

        config PORT
            int "Port"
            range 0 65535
            default 15651
            help
                The remote port to which the client example will send data.

        choice TRANSPORT_LAYER
            prompt "Transport Layer"
            default TRANSPORT_MQTT
            help
                Selects the transport layer protocol.

            config TRANSPORT_UDP
                bool "send over UDP"

            config TRANSPORT_TCP
                bool "send over TCP"
        endchoice
    endmenu

    menu "Button Configuration"
    config BUTTON_GPIO_LEFT
        int "Button GPIO"
        default 9
        help
            GPIO the Button is connected to. In the book it is 6, the book development board uses 9

    config BUTTON_GPIO_RIGHT
        int "Button GPIO"
        default 2
        help
            GPIO the Button is connected to. The book development board uses 2

    config ENABLE_GPIO_PULLDOWN
        int "Changes PullUp to PullDown"
        range 0 1
        default 0
        help
            If the Button should be configured to use PullDown. Uses PullUp otherwise.
    endmenu
endmenu
```

## Lecture7-Bluetooth/main/Kconfig.projbuild
```kconfig
menu "Lecture7 Configuration"
    orsource "$IDF_PATH/examples/common_components/env_caps/$IDF_TARGET/Kconfig.env_caps"

    menu "Button Configuration"
    config BUTTON_GPIO_LEFT
        int "Button GPIO"
        default 9
        help
            GPIO the Button is connected to. In the book it is 6, the book development board uses 9

    config BUTTON_GPIO_RIGHT
        int "Button GPIO"
        default 2
        help
            GPIO the Button is connected to. The book development board uses 2

    config ENABLE_GPIO_PULLDOWN
        bool "Enable GPIO PullDown"
        default y
        help
            If the Button should be configured to use PullDown. Uses PullUp otherwise.
    endmenu

endmenu
```
